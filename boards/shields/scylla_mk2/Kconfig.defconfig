## boards/shields/scylla_mk2/Kconfig.shield
```kconfig
config SHIELD_SCYLLA_MK2_LEFT
    def_bool $(shields_list_contains,scylla_mk2_left)

config SHIELD_SCYLLA_MK2_RIGHT
    def_bool $(shields_list_contains,scylla_mk2_right)
```
